## examples/control/sdkconfig.defaults
```kconfig
CONFIG_PM_ENABLE=y
CONFIG_FREERTOS_HZ=1000
CONFIG_FREERTOS_USE_TICKLESS_IDLE=y
CONFIG_GPIO_BUTTON_SUPPORT_POWER_SAVE=y
CONFIG_ESPNOW_LIGHT_SLEEP=y
CONFIG_ESPNOW_CONTROL_AUTO_CHANNEL_SENDING=y
CONFIG_ESPNOW_CONTROL_AUTO_CHANNEL_FORWARD=y
CONFIG_ESPNOW_CONTROL_RETRANSMISSION_TIMES=5
CONFIG_ESPNOW_CONTROL_FORWARD_TTL=10
CONFIG_ESPNOW_CONTROL_FORWARD_RSSI=-55
CONFIG_ESPNOW_DATA_FAST_ACK=y
```
